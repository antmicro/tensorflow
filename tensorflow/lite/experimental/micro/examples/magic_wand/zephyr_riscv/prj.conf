## CMakeLists.txt
```
cmake_minimum_required(VERSION 3.13.1)
include($ENV{ZEPHYR_BASE}/cmake/app/boilerplate.cmake NO_POLICY_SCOPE)
project(tf_lite_magic_wand)

set(TF_MICRO_DIR $ENV{TF_BASE}/tensorflow/lite/experimental/micro)
file(GLOB MICRO_SOURCES ${TF_MICRO_DIR}/*cc)
file(GLOB MICRO_HEADERS ${TF_MICRO_DIR}/*.h)
file(GLOB MICRO_TESTS_SOURCES ${TF_MICRO_DIR}/*test.cc)
file(GLOB MICRO_KERNELS_SOURCES ${TF_MICRO_DIR}/kernels/*cc)
file(GLOB MICRO_KERNELS_HEADERS ${TF_MICRO_DIR}/kernels/*.h)
file(GLOB MICRO_TESTS_KERNELS_SOURCES ${TF_MICRO_DIR}/kernels/*test.cc)
file(GLOB MICRO_MEMORY_SOURCES ${TF_MICRO_DIR}/memory_planner/*cc)
file(GLOB MICRO_MEMORY_HEADERS ${TF_MICRO_DIR}/memory_planner/*.h)
file(GLOB MICRO_TESTS_MEMORY_SOURCES ${TF_MICRO_DIR}/memory_planner/*test.cc)

# remove test sources from app sources
list(REMOVE_ITEM MICRO_SOURCES ${MICRO_TESTS_SOURCES})
list(REMOVE_ITEM MICRO_KERNELS_SOURCES ${MICRO_TESTS_KERNELS_SOURCES})
list(REMOVE_ITEM MICRO_MEMORY_SOURCES ${MICRO_TESTS_MEMORY_SOURCES})

# -fno-threadsafe-statics -- disables the mutex around initialization of local static variables
target_compile_options(app PRIVATE "-fno-threadsafe-statics")

target_sources(app PRIVATE
                src/assert.cc
                src/accelerometer_handler.cc
                src/accelerometer_handler.h
                src/constants.cc
                ../output_handler.cc
                ../output_handler.h
                ../gesture_predictor.cc
                ../constants.h
                ../gesture_predictor.h
                ../main.cc
                ../main_functions.cc
                ../magic_wand_model_data.cc
                ../main_functions.h
                ../magic_wand_model_data.h
                ${MICRO_SOURCES}
                ${MICRO_KERNELS_SOURCES}
                ${MICRO_MEMORY_SOURCES}
                ${MICRO_HEADERS}
                ${MICRO_KERNEL_HEADERS}
                ${MICRO_MEMORY_HEADERS}
                $ENV{TF_BASE}/tensorflow/lite/c/c_api_internal.c
                $ENV{TF_BASE}/tensorflow/lite/core/api/error_reporter.cc
                $ENV{TF_BASE}/tensorflow/lite/core/api/flatbuffer_conversions.cc
                $ENV{TF_BASE}/tensorflow/lite/core/api/op_resolver.cc
                $ENV{TF_BASE}/tensorflow/lite/core/api/tensor_utils.cc
                $ENV{TF_BASE}/tensorflow/lite/kernels/internal/quantization_util.cc
                $ENV{TF_BASE}/tensorflow/lite/kernels/kernel_util.cc

                )

target_include_directories(app PRIVATE
                $ENV{TF_BASE}
                $ENV{TF_BASE}/tensorflow/lite/experimental/micro/tools/make/downloads/gemmlowp
                $ENV{TF_BASE}/tensorflow/lite/experimental/micro/tools/make/downloads/flatbuffers/include
                $ENV{TOOLCHAIN_BASE}/include/c++/$ENV{TOOLCHAIN_VERSION}
                $ENV{TOOLCHAIN_BASE}/include
                $ENV{TOOLCHAIN_BASE}/include/c++/$ENV{TOOLCHAIN_VERSION}/riscv32-zephyr-elf/rv32i/ilp32
                )

add_definitions(-DNDEBUG -DTF_LITE_STATIC_MEMORY)
```

## prj.conf
```kconfig
CONFIG_CPLUSPLUS=y
CONFIG_NEWLIB_LIBC=y
CONFIG_SENSOR=y
CONFIG_ADXL345=y
```

## src/accelerometer_handler.cc
```c
/* Copyright 2019 The TensorFlow Authors. All Rights Reserved.

Licensed under the Apache License, Version 2.0 (the "License");
you may not use this file except in compliance with the License.
You may obtain a copy of the License at

    http://www.apache.org/licenses/LICENSE-2.0

Unless required by applicable law or agreed to in writing, software
distributed under the License is distributed on an "AS IS" BASIS,
WITHOUT WARRANTIES OR CONDITIONS OF ANY KIND, either express or implied.
See the License for the specific language governing permissions and
limitations under the License.
==============================================================================*/

#include "tensorflow/lite/experimental/micro/examples/magic_wand/accelerometer_handler.h"
#include <stdio.h>
#include <zephyr.h>
#include <device.h>
#include <string.h>
#include <drivers/sensor.h>

#define BUFLEN 300
int begin_index = 0;
struct device *sensor = NULL;
int current_index = 0;

float bufx[BUFLEN] = {0.0};
float bufy[BUFLEN] = {0.0};
float bufz[BUFLEN] = {0.0};

bool initial = true;

TfLiteStatus SetupAccelerometer(tflite::ErrorReporter* error_reporter) {
  sensor = device_get_binding("accel-0");
  if(sensor == NULL) {
    error_reporter->Report("Failed to get accelerometer\n");
  }
  error_reporter->Report("Got accelerometer\n");
  return kTfLiteOk;
}

bool ReadAccelerometer(tflite::ErrorReporter* error_reporter, float* input,
                       int length, bool reset_buffer) {
  int rc;
  struct sensor_value accel[3];
  int samples_count;

  if(reset_buffer) {
    memset(bufx, 0, BUFLEN*sizeof(float));
    memset(bufy, 0, BUFLEN*sizeof(float));
    memset(bufz, 0, BUFLEN*sizeof(float));
    begin_index = 0;
    initial = true;
  }

  rc = sensor_sample_fetch(sensor);
  if(rc < 0) {
    error_reporter -> Report("Fetch failed\n");
    return false;
  }
  // skip if there is no data
  if(!rc) {
    return false;
  }

  samples_count = rc;
  for(int i = 0; i < samples_count; i++) {
    rc = sensor_channel_get(sensor,
                            SENSOR_CHAN_ACCEL_XYZ,
                            accel);
    if (rc < 0) {
      error_reporter->Report("ERROR: Update failed: %d\n", rc);
      return false;
    }
    bufx[begin_index] = sensor_value_to_double(&accel[0]);
    bufy[begin_index] = sensor_value_to_double(&accel[1]);
    bufz[begin_index] = sensor_value_to_double(&accel[2]);
    begin_index++;
    if (begin_index >= BUFLEN) begin_index = 0;

  }

  if(initial && begin_index >= 100) {
    initial = false;
  }

  if (initial) {
    return false;
  }

  int sample = 0;
  for (int i = 0; i < length; i+=3) {
    int ring_index = begin_index + sample - length/3;
    if(ring_index < 0) {
      ring_index += BUFLEN;
    }
    input[i] =   bufx[ring_index];
    input[i+1] = bufy[ring_index];
    input[i+2] = bufz[ring_index];
    sample++;
  }
  return true;
}
```

## src/constants.cc
```c
/* Copyright 2019 The TensorFlow Authors. All Rights Reserved.

Licensed under the Apache License, Version 2.0 (the "License");
you may not use this file except in compliance with the License.
You may obtain a copy of the License at

    http://www.apache.org/licenses/LICENSE-2.0

Unless required by applicable law or agreed to in writing, software
distributed under the License is distributed on an "AS IS" BASIS,
WITHOUT WARRANTIES OR CONDITIONS OF ANY KIND, either express or implied.
See the License for the specific language governing permissions and
limitations under the License.
==============================================================================*/

#include "tensorflow/lite/experimental/micro/examples/magic_wand/constants.h"

// The number of expected consecutive inferences for each gesture type.
// These defaults were established with the SparkFun Edge board.
const int kConsecutiveInferenceThresholds[3] = {1, 1, 1};
```
